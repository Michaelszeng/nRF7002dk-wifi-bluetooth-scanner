## prj.conf
```kconfig
# WIFI SCAN
CONFIG_WIFI=y
CONFIG_WIFI_NRF700X=y
CONFIG_NET_L2_WIFI_MGMT=y
CONFIG_HEAP_MEM_POOL_SIZE=25000

# System settings
CONFIG_NEWLIB_LIBC=y

# Networking
CONFIG_NETWORKING=y
CONFIG_NET_L2_ETHERNET=y
CONFIG_NET_NATIVE=n
CONFIG_NET_OFFLOAD=y

CONFIG_INIT_STACKS=y

# Debugging
CONFIG_STACK_SENTINEL=y
CONFIG_DEBUG_COREDUMP=y
CONFIG_DEBUG_COREDUMP_BACKEND_LOGGING=y
CONFIG_DEBUG_COREDUMP_MEMORY_DUMP_MIN=y

# Logging
CONFIG_LOG=y
CONFIG_PRINTK=y
# CONFIG_LOG_MODE_MINIMAL=y
CONFIG_USE_SEGGER_RTT=y
CONFIG_SEGGER_RTT_BUFFER_SIZE_UP=4096

# printing of scan results puts pressure on queues in new locking
# design in net_mgmt. So, use a higher timeout for a crowded
# environment.
CONFIG_NET_MGMT_EVENT_QUEUE_TIMEOUT=5000

# Vendor Specfic IE
CONFIG_WIFI_MGMT_RAW_SCAN_RESULTS=y





# BLUETOOTH SCAN
# CONFIG_NCS_SAMPLES_DEFAULTS=y

# CONFIG_HEAP_MEM_POOL_SIZE=2048

CONFIG_BT=y
CONFIG_BT_DEBUG_LOG=y
CONFIG_BT_CENTRAL=y
CONFIG_BT_GATT_CLIENT=y
CONFIG_BT_GATT_DM=y

CONFIG_BT_SCAN=y
CONFIG_BT_SCAN_FILTER_ENABLE=n
CONFIG_BT_SCAN_UUID_CNT=1

CONFIG_BT_CTLR_ADV_EXT=y
CONFIG_BT_CTLR_PHY_CODED=y

CONFIG_BT_EXT_ADV=y
CONFIG_BT_USER_PHY_UPDATE=y
```

## src/main.c
```c
/*
 * Copyright (c) 2022 Nordic Semiconductor ASA
 *
 * SPDX-License-Identifier: LicenseRef-Nordic-5-Clause
 */

/** @file
 * @brief WiFi and Bluetooth Scanner + RID Data Parser
 */

#include <zephyr/logging/log.h>
LOG_MODULE_REGISTER(scan, CONFIG_LOG_DEFAULT_LEVEL);


#include <nrfx_clock.h>
#include <zephyr/kernel.h>
#include <stdio.h>
#include <stdlib.h>
#include <zephyr/shell/shell.h>
#include <zephyr/sys/printk.h>
#include <zephyr/init.h>

#include <zephyr/net/net_if.h>
#include <zephyr/net/wifi_mgmt.h>
#include <zephyr/net/net_event.h>

#include <zephyr/types.h>
#include <stddef.h>
#include <errno.h>
#include <zephyr/sys/byteorder.h>

#include <zephyr/bluetooth/bluetooth.h>
#include <zephyr/bluetooth/conn.h>
#include <zephyr/bluetooth/uuid.h>
#include <zephyr/bluetooth/gatt.h>
#include <bluetooth/gatt_dm.h>
#include <bluetooth/scan.h>

#include "net_private.h"

#include "enums.h"
#include "utils.h"
#include "wifi_scan.h"
#include "bluetooth_scan.h"


void handle_wifi_raw_scan_result(struct net_mgmt_event_callback *cb) {
	struct wifi_raw_scan_result *raw =
		(struct wifi_raw_scan_result *)cb->info;
	int channel;
	int band;
	int rssi;
	uint8_t mac_string_buf[sizeof("xx:xx:xx:xx:xx:xx")];

	rssi = raw->rssi;
	channel = wifi_freq_to_channel(raw->frequency);
	band = wifi_freq_to_band(raw->frequency);

	int odid_identifier_idx = contains(raw->data, sizeof(raw->data), identifier, sizeof(identifier));

	// if (rssi >= -14) {
	if (odid_identifier_idx != -1) {
		LOG_INF("WIFI SCAN RECEIVED\n");
		LOG_INF("%-4u (%-6s) | %-4d | %s |      %-4d        ",
			channel,
			wifi_band_txt(band),
			rssi,
			net_sprint_ll_addr_buf(raw->data + 10, WIFI_MAC_ADDR_LEN, mac_string_buf, sizeof(mac_string_buf)), raw->frame_length);
		
		if (PRINT_INFO) {
			k_sleep(K_SECONDS(0.01));
			log_hexdump(raw->data, sizeof(raw->data));
			k_sleep(K_SECONDS(0.01));
			printf("\n\n\n");
		}

		// flags to hold whether or not a certain message was received
		msg_flags_t msg_flags;
		msg_flags.basic_id_flag = 0;
		msg_flags.location_vector_flag = 0;
		msg_flags.authentication_flag = 0;
		msg_flags.self_id_flag = 0;
		msg_flags.system_flag = 0;
		msg_flags.operator_id_flag = 0;

		uint8_t num_msg_in_pack = raw->data[odid_identifier_idx+7];

		parse_hex(raw->data, sizeof(raw->data), odid_identifier_idx, num_msg_in_pack, &msg_flags);
	}
}




static void handle_bluetooth_scan_result(struct bt_scan_device_info *device_info) {
	int err;
	char addr[BT_ADDR_LE_STR_LEN];
	struct bt_conn_le_create_param *conn_params;

	bt_addr_le_to_str(device_info->recv_info->addr, addr, sizeof(addr));

	uint16_t hex_dump_len = device_info->adv_data->len;

	printk("\nHex Dump Length: %d\n", hex_dump_len);
	printk("Raw Hex Dump: \n");
	log_hexdump(device_info->adv_data->data, hex_dump_len);
	printk("\n");

	err = bt_scan_stop();
	if (err) {
		printk("Stop LE scan failed (err %d)\n", err);
	}
	bt_scan_finished = 1;  // set global variable to indicate scanning is not longer in progress
}



int main(void) {
	LOG_INF("==================================PROGRAM STARTING==================================");


	// wifi event callback
	net_mgmt_init_event_callback(&wifi_shell_mgmt_cb,
				     wifi_mgmt_event_handler,
				     WIFI_SHELL_MGMT_EVENTS);
	net_mgmt_add_event_callback(&wifi_shell_mgmt_cb);
	printk("Wi-Fi initialized\n");



	// bluetooth initialization
	BT_SCAN_CB_INIT(bluetooth_scan_cb, NULL, handle_bluetooth_scan_result, NULL, NULL);  // only pass in callback for when no filters matched (so whenever any BT coded phy is detected)
	int err = bt_enable(NULL);
	if (err) {
		printk("Bluetooth init failed (err %d)\n", err);
		return 0;
	}
	printk("Bluetooth initialized\n");

	// bluetooth event callback
	bluetooth_scan_init();
	bt_scan_cb_register(&bluetooth_scan_cb);



#ifdef CLOCK_FEATURE_HFCLK_DIVIDE_PRESENT
	/* For now hardcode to 128MHz */
	nrfx_clock_divider_set(NRF_CLOCK_DOMAIN_HFCLK,
			       NRF_CLOCK_HFCLK_DIV_1);
#endif
	LOG_INF("Starting %s with CPU frequency: %d MHz", CONFIG_BOARD, SystemCoreClock / MHZ(1));  // should be nrf7002dk_nrf5340_cpuapp with 128 MHz



	// Conduct wifi scan
	wifi_scan_finished = 1;
	while(1) {
		if (wifi_scan_finished == 1) {  // only perform a scan if not another scan is currently in progress
			wifi_scan();
		}
		k_sleep(K_SECONDS(0.01));
	}

	//conduct bluetooth scan
	bt_scan_finished = 1;
	while(1) {
		if (bt_scan_finished == 1) {  // only perform a scan if not another scan is currently in progress
			err = bt_scan_start(BT_SCAN_TYPE_SCAN_ACTIVE);
			bt_scan_finished = 0;  // set global variable to indicate scanning currently in progresss
			if (err) {
				printk("Scanning failed to start (err %d)\n", err);
				k_sleep(K_SECONDS(1));  // sleep then try again
			}
			// printk("Scanning successfully started\n");
		}
		k_sleep(K_SECONDS(0.01));
	}



	LOG_INF("EXITED LOOP");
	
	return 0;
}
```

## src/bluetooth_scan.h
```c
#include <stdio.h>
#include <stdlib.h>

#include <zephyr/bluetooth/bluetooth.h>
#include <zephyr/bluetooth/conn.h>
#include <zephyr/bluetooth/uuid.h>
#include <zephyr/bluetooth/gatt.h>
#include <bluetooth/gatt_dm.h>
#include <bluetooth/scan.h>

static uint8_t bt_scan_finished;


static void bluetooth_scan_init(void) {
	/* Use active scanning and disable duplicate filtering to handle any
	 * devices that might update their advertising data at runtime. */
	struct bt_le_scan_param scan_param = {
		.type     = BT_LE_SCAN_TYPE_PASSIVE,
		.interval = BT_GAP_SCAN_FAST_INTERVAL,
		.window   = BT_GAP_SCAN_FAST_WINDOW,
		.options  = BT_LE_SCAN_OPT_CODED | BT_LE_SCAN_OPT_NO_1M
	};

	struct bt_scan_init_param scan_init = {
		.connect_if_match = 0,
		.scan_param = &scan_param,
		.conn_param = NULL
	};

	bt_scan_init(&scan_init);
}
```

## src/utils.h
```c
#include <stdio.h>
#include <stdlib.h>




// printing hexdump for wifi scans
#define PRINT_INFO 1





// array of ASCII chars, where their index in the array corresponds to its decimal representation.
// chars that aren't needed for our purposes are left as underscores
const char ASCII_DICTIONARY[] = {'0', '_', '_', '_', '_', '_', '_', '_', '_', '_', '_', '_', '_', '_', '_', '_', '_', '_', '_', '_', '_', '_', '_', '_', '_', '_', '_', '_', '_', '_', '_', '_', '_', '_', '_', '_', '_', '_', '_', '_', '_', '_', '_', '_', '_', '-', '.', '_', '0', '1', '2', '3', '4', '5', '6', '7', '8', '9', '_', '_', '_', '_', '_', '_', '_', 'A', 'B', 'C', 'D', 'E', 'F', 'G', 'H', 'I', 'J', 'K', 'L', 'M', 'N', 'O', 'P', 'Q', 'R', 'S', 'T', 'U', 'V', 'W', 'X', 'Y', 'Z'};
// array of hex chars, where their index in the array corresponds to its decimal representation
const char* const HEX_DICTIONARY[] = {"00", "01", "02", "03", "04", "05", "06", "07", "08", "09", "0A", "0B", "0C", "0D", "0E", "0F", "10", "11", "12", "13", "14", "15", "16", "17", "18", "19", "1A", "1B", "1C", "1D", "1E", "1F", "20", "21", "22", "23", "24", "25", "26", "27", "28", "29", "2A", "2B", "2C", "2D", "2E", "2F", "30", "31", "32", "33", "34", "35", "36", "37", "38", "39", "3A", "3B", "3C", "3D", "3E", "3F", "40", "41", "42", "43", "44", "45", "46", "47", "48", "49", "4A", "4B", "4C", "4D", "4E", "4F", "50", "51", "52", "53", "54", "55", "56", "57", "58", "59", "5A", "5B", "5C", "5D", "5E", "5F", "60", "61", "62", "63", "64", "65", "66", "67", "68", "69", "6A", "6B", "6C", "6D", "6E", "6F", "70", "71", "72", "73", "74", "75", "76", "77", "78", "79", "7A", "7B", "7C", "7D", "7E", "7F", "80", "81", "82", "83", "84", "85", "86", "87", "88", "89", "8A", "8B", "8C", "8D", "8E", "8F", "90", "91", "92", "93", "94", "95", "96", "97", "98", "99", "9A", "9B", "9C", "9D", "9E", "9F", "A0", "A1", "A2", "A3", "A4", "A5", "A6", "A7", "A8", "A9", "AA", "AB", "AC", "AD", "AE", "AF", "B0", "B1", "B2", "B3", "B4", "B5", "B6", "B7", "B8", "B9", "BA", "BB", "BC", "BD", "BE", "BF", "C0", "C1", "C2", "C3", "C4", "C5", "C6", "C7", "C8", "C9", "CA", "CB", "CC", "CD", "CE", "CF", "D0", "D1", "D2", "D3", "D4", "D5", "D6", "D7", "D8", "D9", "DA", "DB", "DC", "DD", "DE", "DF", "E0", "E1", "E2", "E3", "E4", "E5", "E6", "E7", "E8", "E9", "EA", "EB", "EC", "ED", "EE", "EF", "F0", "F1", "F2", "F3", "F4", "F5", "F6", "F7", "F8", "F9", "FA", "FB", "FC", "FD", "FE", "FF"};


typedef struct {
    uint8_t basic_id_flag;
    uint8_t location_vector_flag;
    uint8_t authentication_flag;
    uint8_t self_id_flag;
    uint8_t system_flag;
    uint8_t operator_id_flag;
} msg_flags_t;


void parse_hex(uint8_t* data, int len, int odid_identifier_idx, uint8_t num_msg_in_pack, msg_flags_t* msg_flags) {
    /*
	 @brief: the hex-string (from either wifi scan or bluetooth scan) into RID data fields

     @param[in]  data: buffer of uint8_t that was directly populated from the wifi or bluetooth scans
     @param[in]  len: length of data
     @param[in]  odid_identifier_idx: index in the data buffer of '0D'
     @param[in]  num_msg_in_pack: number of messages in the message pack (max of 9)
     @param[in]  msg_flags: ptr to struct of flags; after this function is run, the flags will be updated to reflect which messages were in the message packs
	 */

    for (int msg_num=0; msg_num<num_msg_in_pack; msg_num++) {
        int msg_type = (data[odid_identifier_idx + 8 + msg_num*25] - 2) / 16;  // either 0 (Basic ID), 1 (Location/Vector), 2 (Authentication), 3 (Self-ID), 4 (System), or 5 (Operator ID)
        
        switch(msg_type) {  // Decode the raw data into useful RID information
            case 0:  // Basic ID Message
                enum UA_TYPE ua_type = data[odid_identifier_idx + 8 + msg_num*25 + 1] % 16;
                enum ID_TYPE id_type = data[odid_identifier_idx + 8 + msg_num*25 + 1] / 16;  // floor division
                if (PRINT_INFO) {
                    printf("ID TYPE: %s.  ", ID_TYPE_STRING[id_type]);
                    printf("UA TYPE: %s.  ", UA_TYPE_STRING[ua_type]);
                }
                
                switch(id_type) {
                    // Using curly bracs around each case to define each case as it's own frame to prevent redeclaration errors for id_buf
                    case 0:{  // None --> null ID
                        char id_buf[] = {'0', '0', '0', '0', '0', '0', '0', '0', '0', '0', '0', '0', '0', '0', '0', '0', '0', '0', '0', '0', '\0'};
                        if (PRINT_INFO) {
                            printf("NULL UAV ID: %s.\n\n", id_buf);
                        }
                        break;
                    }
                    case 1:  // Serial Number
                    case 2:{  // CAA Registration
                        // Loop through the Serial number in the raw decimal data and build a new string containing the serial number in ASCII
                        char id_buf[21];  // initalize char array to hold the serial number (which is at most 20 ASCII chars)
                        for (int i=0; i<20; i++) {
                            int decimal_val = data[odid_identifier_idx + 8 + msg_num*25 + 2+i];
                            id_buf[i] = ASCII_DICTIONARY[decimal_val];
                        }
                        id_buf[20] = '\0';
                        if (PRINT_INFO) {
                            printf("SERIAL NUMBER/CAA REGISTRATION NUMBER: %s.\n\n", id_buf);
                        }
                        break;
                    }
                    case 3:{  // UTM UUID (should be encoded as a 128-bit UUID (32-char hex string))
                        char id_buf[33];
                        for (int i=0; i<16; i++) {
                            int decimal_val = data[odid_identifier_idx + 8 + msg_num*25 + 2+i];
                            id_buf[2*i] = HEX_DICTIONARY[decimal_val][0];  // 1st hex char in an array of 2 hex chars
                            id_buf[2*i+1] = HEX_DICTIONARY[decimal_val][1];  // 2nd hex char in an array of 2 hex chars
                        }
                        id_buf[32] = '\0';
                        if (PRINT_INFO) {
                            printf("UTM UUID: %s.\n\n", id_buf);
                        }
                        break;
                    }							
                    case 4:{  // Specific Session ID (1st byte is an in betwen 0 and 255, and 19 remaining bytes are alphanumeric code, according to this: https://www.rfc-editor.org/rfc/rfc9153.pdf)
                        char id_buf[21];
                        id_buf[0] = data[odid_identifier_idx + 8 + msg_num*25 + 2];
                        // sprintf(id_buf[0], "%d", data[odid_identifier_idx + 8 + msg_num*25 + 2]);
                        // Loop through the Session ID in the raw decimal data and build a new string containing the serial number in ASCII
                        for (int i=1; i<20; i++) {
                            int decimal_val = data[odid_identifier_idx + 8 + msg_num*25 + 2+i];
                            id_buf[i] = ASCII_DICTIONARY[decimal_val];
                        }
                        id_buf[20] = '\0';
                        if (PRINT_INFO) {
                            printf("SPECIFIC SESSION ID: %s.\n\n", id_buf);
                        }
                        break;
                    }
                }
                msg_flags->basic_id_flag = 1;
                break;
            case 1:  // Location/Vector Message
                enum OPERATIONAL_STATUS op_status = data[odid_identifier_idx + 8 + msg_num*25 + 1] / 16;  // floor division
                // funky modulos & floor division to get the value of each bit
                enum HEIGHT_TYPE height_type_flag = (data[odid_identifier_idx + 8 + msg_num*25 + 1] % 8) / 4;  // 0: Above Takeoff. 1: AGL
                enum E_W_DIRECTION_SEGMENT direction_segment_flag = (data[odid_identifier_idx + 8 + msg_num*25 + 1] % 4) / 2;  // 0: <180, 1: >=180
                enum SPEED_MULTIPLIER speed_multiplier_flag = data[odid_identifier_idx + 8 + msg_num*25 + 1] % 2;;  // 0: x0.25, 1: x0.75

                uint8_t track_direction = data[odid_identifier_idx + 8 + msg_num*25 + 2];  // direction measured clockwise from true north. Should be between 0-179
                if (direction_segment_flag) {  // If E_W_DIRECTION_SEGMENT is true, add 180 to the track_direction, according to ASTM.
                    track_direction += 180;
                }

                uint8_t speed = data[odid_identifier_idx + 8 + msg_num*25 + 3];  // ground speed in m/s
                if (speed_multiplier_flag) {
                    speed = 0.75*speed + 255*0.25;  // as defined in ASTM
                }
                else {
                    speed *= 0.25;
                }

                uint8_t vertical_speed = data[odid_identifier_idx + 8 + msg_num*25 + 4] * 0.5;  // vertical speed in m/s (positive = up, negatve = down); multiply by 0.5 as defined in ASTM

                // lat and lon Little Endian encoded
                int32_t lat_lsb = data[odid_identifier_idx + 8 + msg_num*25 + 5];
                int32_t lat_lsb1 = data[odid_identifier_idx + 8 + msg_num*25 + 6] << 8;  // multiply by 2^8
                int32_t lat_msb1 = data[odid_identifier_idx + 8 + msg_num*25 + 7] << 16;  // multiply by 2^16
                int32_t lat_msb = data[odid_identifier_idx + 8 + msg_num*25 + 8] << 24;  // multiply by 2^24
                int32_t lat_int = lat_msb + lat_msb1 + lat_lsb1 + lat_lsb;
                float lat = (float) lat_int / 10000000.0;  // divide by 10^7, according to ASTM

                int32_t lon_lsb = data[odid_identifier_idx + 8 + msg_num*25 + 9];
                int32_t lon_lsb1 = data[odid_identifier_idx + 8 + msg_num*25 + 10] << 8;  // multiply by 2^8
                int32_t lon_msb1 = data[odid_identifier_idx + 8 + msg_num*25 + 11] << 16;  // multiply by 2^16
                int32_t lon_msb = data[odid_identifier_idx + 8 + msg_num*25 + 12] << 24;  // multiply by 2^24
                int32_t lon_int = lon_msb + lon_msb1 + lon_lsb1 + lon_lsb;
                float lon = (float) lon_int / 10000000.0;  // divide by 10^7, according to ASTM

                // altitudes and height Little Endian encoded
                uint16_t pressure_altitude_lsb = data[odid_identifier_idx + 8 + msg_num*25 + 13];
                uint16_t pressure_altitude_msb = data[odid_identifier_idx + 8 + msg_num*25 + 14] << 8;
                uint16_t pressure_altitude = (pressure_altitude_msb + pressure_altitude_lsb) * 0.5 - 1000;

                uint16_t geodetic_altitude_lsb = data[odid_identifier_idx + 8 + msg_num*25 + 15];
                uint16_t geodetic_altitude_msb = data[odid_identifier_idx + 8 + msg_num*25 + 16] << 8;
                uint16_t geodetic_altitude = (geodetic_altitude_msb + geodetic_altitude_lsb) * 0.5 - 1000;

                uint16_t height_lsb = data[odid_identifier_idx + 8 + msg_num*25 + 17];
                uint16_t height_msb = data[odid_identifier_idx + 8 + msg_num*25 + 18] << 8;
                uint16_t height = (height_msb + height_lsb) * 0.5 - 1000;

                enum VERTICAL_HORIZONTAL_BARO_ALT_ACCURACY vertical_accuracy = data[odid_identifier_idx + 8 + msg_num*25 + 19] / 16;  // floor division
                enum VERTICAL_HORIZONTAL_BARO_ALT_ACCURACY horizontal_accuracy = data[odid_identifier_idx + 8 + msg_num*25 + 19] % 16;
                
                enum VERTICAL_HORIZONTAL_BARO_ALT_ACCURACY baro_alt_accuracy = data[odid_identifier_idx + 8 + msg_num*25 + 20] / 16;  // floor division
                enum SPEED_ACCURACY speed_accuracy = data[odid_identifier_idx + 8 + msg_num*25 + 20] % 16;

                // 1/10ths of seconds since the last hour relatve to UTC time
                uint16_t timestamp_lsb = data[odid_identifier_idx + 8 + msg_num*25 + 21];
                uint16_t timestamp_msb = data[odid_identifier_idx + 8 + msg_num*25 + 21] << 8;
                uint16_t timestamp = timestamp_msb + timestamp_lsb;

                uint8_t timestamp_accuracy_int = (data[odid_identifier_idx + 8 + msg_num*25 + 22] % 15);  // modulo 15 to get rid of bits 7-4. Between 0.1 s and 1.5 s (0 s = unknown)
                float timestamp_accuracy = timestamp_accuracy_int * 0.1;
                
                if (PRINT_INFO) {
                    printf("OPERATIONAL STATUS: %s.  ", OPERATIONAL_STATUS_STRING[op_status]);
                    printf("HEIGHT TYPE: %s.  ", HEIGHT_TYPE_STRING[height_type_flag]);
                    printf("DIRECTION SEGMENT FLAG: %s.  ", E_W_DIRECTION_SEGMENT_STRING[direction_segment_flag]);
                    printf("SPEED MULTIPLIER FLAG: %s.  ", SPEED_MULTIPLIER_STRING[speed_multiplier_flag]);
                    printf("HEADING (deg): %d.  ", track_direction);
                    printf("SPEED (m/s): %d.  ", speed);
                    printf("VERTICAL SPEED (m/s): %d.  ", vertical_speed);
                    printf("LAT: %d.  ", lat_int);
                    printf("LON: %d.  ", lon_int);
                    printf("PRESSURE ALT: %d.  ", pressure_altitude);
                    printf("GEO ALT: %d.  ", geodetic_altitude);
                    printf("HEIGHT: %d.  ", height);
                    printf("HORIZONTAL ACCURACY: %s.  ", VERTICAL_HORIZONTAL_BARO_ALT_ACCURACY_STRING[horizontal_accuracy]);
                    printf("VERTICAL ACCURACY: %s.  ", VERTICAL_HORIZONTAL_BARO_ALT_ACCURACY_STRING[vertical_accuracy]);
                    printf("BARO ALT ACCURACY: %s.  ", VERTICAL_HORIZONTAL_BARO_ALT_ACCURACY_STRING[baro_alt_accuracy]);
                    printf("SPEED ACCURACY: %s.  ", SPEED_ACCURACY_STRING[speed_accuracy]);
                    printf("TIMESTAMP: %d.  ", timestamp);
                    printf("TIMESTAMP_ACCURACY (btwn 0.1-1.5s): %f\n\n", timestamp_accuracy);
                }

                msg_flags->location_vector_flag = 1;
                break;
            case 3:  // Self ID Message
                enum SELF_ID_TYPE self_id_type = data[odid_identifier_idx + 8 + msg_num*25 + 1];
                // Loop through the self id description in the raw decimal data and build a new string containing the self id description in ASCII
                char self_id_description_buf[24];  // initalize char array to hold self id description
                for (int i=0; i<23; i++) {
                    int decimal_val = data[odid_identifier_idx + 8 + msg_num*25 + 2 + i];
                    self_id_description_buf[i] = ASCII_DICTIONARY[decimal_val];
                }
                self_id_description_buf[23] = '\0';
                
                if (PRINT_INFO) {
                    printf("SELF ID TYPE: %s.  ", SELF_ID_TYPE_STRING[self_id_type]);
                    printf("SELF ID: %s.\n\n", self_id_description_buf);
                }
                msg_flags->self_id_flag = 1;
                break;
            case 4:  // System Message
                enum OPERATOR_LOCATION_ALTITUDE_SOURCE_TYPE operator_location_type = data[odid_identifier_idx + 8 + msg_num*25 + 1] % 3; // mod 3 so that we only consider bits 1 and 0
                
                // lat and lon Little Endian encoded
                int32_t operator_lat_lsb = data[odid_identifier_idx + 8 + msg_num*25 + 2];
                int32_t operator_lat_lsb1 = data[odid_identifier_idx + 8 + msg_num*25 + 3] << 8;  // multiply by 2^8
                int32_t operator_lat_msb1 = data[odid_identifier_idx + 8 + msg_num*25 + 4] << 16;  // multiply by 2^16
                int32_t operator_lat_msb = data[odid_identifier_idx + 8 + msg_num*25 + 5] << 24;  // multiply by 2^24
                int32_t operator_lat_int = operator_lat_msb + operator_lat_msb1 + operator_lat_lsb1 + operator_lat_lsb;
                float operator_lat = (float) operator_lat_int / 10000000.0;

                int32_t operator_lon_lsb = data[odid_identifier_idx + 8 + msg_num*25 + 6];
                int32_t operator_lon_lsb1 = data[odid_identifier_idx + 8 + msg_num*25 + 7] << 8;  // multiply by 2^8
                int32_t operator_lon_msb1 = data[odid_identifier_idx + 8 + msg_num*25 + 8] << 16;  // multiply by 2^16
                int32_t operator_lon_msb = data[odid_identifier_idx + 8 + msg_num*25 + 9] << 24;  // multiply by 2^24
                int32_t operator_lon_int = operator_lon_msb + operator_lon_msb1 + operator_lon_lsb1 + operator_lon_lsb;
                float operator_lon = (float) operator_lon_int / 10000000.0;

                // number of aircraft in the area
                uint16_t area_count_lsb = data[odid_identifier_idx + 8 + msg_num*25 + 10];
                uint16_t area_count_msb = data[odid_identifier_idx + 8 + msg_num*25 + 11] << 8;  // multiply by 2^8
                uint16_t area_count = area_count_msb + area_count_lsb;

                // radius of cylindrical area with the group of aircraft
                uint16_t area_radius = data[odid_identifier_idx + 8 + msg_num*25 + 12] * 10;

                // floor and ceiling Little Endian encoded
                uint16_t area_ceiling_lsb = data[odid_identifier_idx + 8 + msg_num*25 + 13];
                uint16_t area_ceiling_msb = data[odid_identifier_idx + 8 + msg_num*25 + 14] << 8;
                uint16_t area_ceiling = (area_ceiling_msb + area_ceiling_lsb) * 0.5 - 1000;

                uint16_t area_floor_lsb = data[odid_identifier_idx + 8 + msg_num*25 + 15];
                uint16_t area_floor_msb = data[odid_identifier_idx + 8 + msg_num*25 + 16] << 8;
                uint16_t area_floor = (area_floor_msb + area_floor_lsb) * 0.5 - 1000;

                enum UA_CATEGORY ua_category = data[odid_identifier_idx + 8 + msg_num*25 + 17] / 16;  // floor division
                enum UA_CLASS ua_classification = data[odid_identifier_idx + 8 + msg_num*25 + 17] % 16;
                

                // operator altitude Little Endian encoded
                uint16_t operator_altitude_lsb = data[odid_identifier_idx + 8 + msg_num*25 + 18];
                uint16_t operator_altitude_msb = data[odid_identifier_idx + 8 + msg_num*25 + 19] << 8;
                uint16_t operator_altitude = (operator_altitude_msb + operator_altitude_lsb) * 0.5 - 1000;

                // current time in seconds since 00:00:00 01/01/2019
                uint32_t system_timestamp_lsb = data[odid_identifier_idx + 8 + msg_num*25 + 20];
                uint32_t system_timestamp_lsb1 = data[odid_identifier_idx + 8 + msg_num*25 + 21] << 8;
                uint32_t system_timestamp_msb1 = data[odid_identifier_idx + 8 + msg_num*25 + 22] << 16;
                uint32_t system_timestamp_msb = data[odid_identifier_idx + 8 + msg_num*25 + 23] << 24;
                uint32_t system_timestamp = system_timestamp_msb + system_timestamp_msb1 + system_timestamp_lsb1 + system_timestamp_lsb;

                if (PRINT_INFO) {
                    printf("OPERATOR LOCATION SOURCE TYPE: %s.  ", OPERATOR_LOCATION_ALTITUDE_SOURCE_TYPE_STRING[operator_location_type]);
                    printf("OPERATOR LAT: %d.  ", operator_lat_int);
                    printf("OPERATOR LON: %d.  ", operator_lon_int);
                    printf("OPERATOR ALT: %d.  ", operator_altitude);
                    printf("AREA COUNT: %d.  ", area_count);
                    printf("AREA RADIUS: %d.  ", area_radius);
                    printf("AREA CEILING: %d.  ", area_ceiling);
                    printf("AREA FLOOR: %d.  ", area_floor);
                    printf("UA CATEGORY: %s.  ", UA_CATEGORY_STRING[ua_category]);
                    printf("UA CLASS: %s.  ", UA_CLASS_STRING[ua_classification]);
                    printf("TIMESTAMP (secs from 00:00:00 01/01/2019): %d.\n\n", system_timestamp);
                }

                msg_flags->system_flag = 1;
                break;
            case 5:  // Operator ID Message
                // Loop through the operator id in the raw decimal data and build a new string containing the operator id in ASCII
                char operator_id_buf[21];  // initalize char array to hold the operator id string (which is at most 20 ASCII chars)
                for (int i=0; i<20; i++) {
                    int decimal_val = data[odid_identifier_idx + 8 + msg_num*25 + 2 + i];
                    operator_id_buf[i] = ASCII_DICTIONARY[decimal_val];
                }
                operator_id_buf[20] = '\0';
                if (PRINT_INFO) {
                    printf("OPERATOR ID (CAA-issued License): %s.\n\n", operator_id_buf);
                }
                msg_flags->operator_id_flag = 1;
                break;
        }
    }
}


void log_hexdump(uint8_t* buf, uint16_t size) {
	/*
	 print the buffer (which should be a scanned wifi packet) as a string of hex chars.
	 */
	for (int i=0; i<size; i++) {
		if (buf[i] < 16) {  // because printing "%x ", for single digit characters omits the first 0
			printk("0");
		}
		printk("%X ", buf[i]);
		k_sleep(K_SECONDS(0.002));  // delay between each character so messages aren't dropped
	}
	printk("\n");
}


int contains(uint8_t big[], int size_b, uint8_t small[], int size_s) {
	/*
	 Checks if a small array is a sub-array of a big array. Returns -1 if it's not,
	 Returns the index of the small array in the big array if it is.
	 */
    int contains, k;
    for(int i = 0; i < size_b; i++){
        // assume that the big array contains the small array
        contains = 1;
        // check if the element at index i in the big array is the same as the first element in the small array
       if(big[i] == small[0]){
           // if yes, then we start from k = 1, because we already know that the first element in the small array is the same as the element at index i in the big array
           k = 1;
           // we start to check if the next elements in the big array are the same as the elements in the small array
           // (we start from i+1 position because we already know that the element at the position i is the same as the first element in the small array)
           for(int j = i + 1; j < size_b; j++){
               // range for k must be from 1 to size_s-1
               if(k >= size_s - 1) {
                   break;
               }
               // if the element at the position j in the big array is different
               // from the element at the position k in the small array then we
               // flag that we did not find the sequence we were looking for (contains=0)
               if(big[j] != small[k]){
                   contains = 0;
                   break;
               }
               // increment k because we want the next element in the small array
               k++;
           }
           // if contains flag is not 0 that means we found the sequence we were looking
           // for and that sequence starts from index i in the big array
           if(contains) {
               return i;
           }
       }
    }
    return -1;  // if the sequence we were looking for was not found
}
```

## src/wifi_scan.h
```c
#include <stdio.h>
#include <stdlib.h>


#define WIFI_SHELL_MODULE "wifi"

// #define WIFI_SHELL_MGMT_EVENTS (NET_EVENT_WIFI_SCAN_RESULT | NET_EVENT_WIFI_SCAN_DONE)
#define WIFI_SHELL_MGMT_EVENTS (NET_EVENT_WIFI_SCAN_DONE |		\
								NET_EVENT_WIFI_RAW_SCAN_RESULT)

// decimal of FA 0B BC 0D
uint8_t identifier[] = {250, 11, 188, 13};

uint8_t wifi_scan_finished;

struct net_mgmt_event_callback wifi_shell_mgmt_cb;


int wifi_freq_to_channel(int frequency) {
	int channel = 0;

	if ((frequency <= 2424) && (frequency >= 2401)) {
		channel = 1;
	} else if ((frequency <= 2453) && (frequency >= 2425)) {
		channel = 6;
	} else if ((frequency <= 2484) && (frequency >= 2454)) {
		channel = 11;
	} else if ((frequency <= 5320) && (frequency >= 5180)) {
		channel = ((frequency - 5180) / 5) + 36;
	} else if ((frequency <= 5720) && (frequency >= 5500)) {
		channel = ((frequency - 5500) / 5) + 100;
	} else if ((frequency <= 5895) && (frequency >= 5745)) {
		channel = ((frequency - 5745) / 5) + 149;
	} else {
		channel = frequency;
	}

	return channel;
}


enum wifi_frequency_bands wifi_freq_to_band(int frequency) {
	enum wifi_frequency_bands band = WIFI_FREQ_BAND_2_4_GHZ;

	if ((frequency  >= 2401) && (frequency <= 2495)) {
		band = WIFI_FREQ_BAND_2_4_GHZ;
	} else if ((frequency  >= 5170) && (frequency <= 5895)) {
		band = WIFI_FREQ_BAND_5_GHZ;
	} else {
		band = WIFI_FREQ_BAND_6_GHZ;
	}

	return band;
}


void handle_wifi_scan_done(struct net_mgmt_event_callback *cb) {
	const struct wifi_status *status =
		(const struct wifi_status *)cb->info;

	if (status->status) {
		LOG_ERR("Scan request failed (%d)", status->status);
	} else {
		wifi_scan_finished = 1;  // set global variable to indicate scanning is not longer in progress
		// LOG_INF("Scan request done");
	}
}


static void wifi_mgmt_event_handler(struct net_mgmt_event_callback *cb,
				     uint32_t mgmt_event, struct net_if *iface) {
	switch (mgmt_event) {
	case NET_EVENT_WIFI_RAW_SCAN_RESULT:
		handle_wifi_raw_scan_result(cb);  // this func call is basically instantaneous
		break;
	case NET_EVENT_WIFI_SCAN_DONE:
		handle_wifi_scan_done(cb);  // this func call is basically instantaneous
		break;
	default:
		break;
	}
}


static int wifi_scan(void) {
	wifi_scan_finished = 0;  // set global variable to indicate scanning currently in progresss
	
	struct net_if *iface = net_if_get_default();

	if (net_mgmt(NET_REQUEST_WIFI_SCAN, iface, NULL, 0)) {
		LOG_ERR("Scan request failed");
		return -ENOEXEC;
	}
	return 0;
}
```
